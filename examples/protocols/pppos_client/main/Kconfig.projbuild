## examples/protocols/pppos_client/main/Kconfig.projbuild
```kconfig
menu "Example Configuration"

    choice EXAMPLE_MODEM_DEVICE
        prompt "Choose supported modem device (DCE)"
        default EXAMPLE_MODEM_DEVICE_BG96
        help
            Select modem device connected to the ESP DTE.
        config EXAMPLE_MODEM_DEVICE_SIM800
            bool "SIM800"
            help
                SIMCom SIM800L is a GSM/GPRS module.
                It supports Quad-band 850/900/1800/1900MHz.
        config EXAMPLE_MODEM_DEVICE_BG96
            bool "BG96"
            help
                Quectel BG96 is a series of LTE Cat M1/Cat NB1/EGPRS module.
        config EXAMPLE_MODEM_DEVICE_SIM7600
            bool "SIM7600"
            help
                SIM7600 is Multi-Band LTE-TDD/LTE-FDD/HSPA+ and GSM/GPRS/EDGE module
    endchoice

    config EXAMPLE_MODEM_PPP_AUTH_USERNAME
        string "Set username for authentication"
        default "espressif"
        depends on !EXAMPLE_MODEM_PPP_AUTH_NONE
        help
            Set username for PPP Authentication.

    config EXAMPLE_MODEM_PPP_AUTH_PASSWORD
        string "Set password for authentication"
        default "esp32"
        depends on !EXAMPLE_MODEM_PPP_AUTH_NONE
        help
            Set password for PPP Authentication.

    config EXAMPLE_MODEM_PPP_AUTH_NONE
        bool "Skip PPP authentication"
        default n
        help
            Set to true for the PPP client to skip authentication

    config EXAMPLE_SEND_MSG
        bool "Short message (SMS)"
        default n
        help
            Select this, the modem will send a short message before power off.

    if EXAMPLE_SEND_MSG
        config EXAMPLE_SEND_MSG_PEER_PHONE_NUMBER
            string "Peer Phone Number (with area code)"
            default "+8610086"
            help
                Enter the peer phone number that you want to send message to.
    endif

    menu "UART Configuration"
        config EXAMPLE_MODEM_UART_TX_PIN
            int "TXD Pin Number"
            default 5
            range 0 31
            help
                Pin number of UART TX.

        config EXAMPLE_MODEM_UART_RX_PIN
            int "RXD Pin Number"
            default 13
            range 0 31
            help
                Pin number of UART RX.

        config EXAMPLE_MODEM_UART_RTS_PIN
            int "RTS Pin Number"
            default 27
            range 0 31
            help
                Pin number of UART RTS.

        config EXAMPLE_MODEM_UART_CTS_PIN
            int "CTS Pin Number"
            default 23
            range 0 31
            help
                Pin number of UART CTS.

        config EXAMPLE_MODEM_UART_EVENT_TASK_STACK_SIZE
            int "UART Event Task Stack Size"
            range 2000 6000
            default 3072
            help
                Stack size of UART event task.

        config EXAMPLE_MODEM_UART_EVENT_TASK_PRIORITY
            int "UART Event Task Priority"
            range 3 22
            default 5
            help
                Priority of UART event task.

        config EXAMPLE_MODEM_UART_EVENT_QUEUE_SIZE
            int "UART Event Queue Size"
            range 10 40
            default 30
            help
                Length of UART event queue.

        config EXAMPLE_MODEM_UART_PATTERN_QUEUE_SIZE
            int "UART Pattern Queue Size"
            range 10 40
            default 20
            help
                Length of UART pattern queue.

        config EXAMPLE_MODEM_UART_TX_BUFFER_SIZE
            int "UART TX Buffer Size"
            range 256 2048
            default 512
            help
                Buffer size of UART TX buffer.

        config EXAMPLE_MODEM_UART_RX_BUFFER_SIZE
            int "UART RX Buffer Size"
            range 256 2048
            default 1024
            help
                Buffer size of UART RX buffer.
    endmenu

endmenu

menu "Modbus Example Configuration"

    config MB_UART_PORT_NUM
        int "UART port number"
        range 0 2 if IDF_TARGET_ESP32
        default 2 if IDF_TARGET_ESP32
        range 0 1 if IDF_TARGET_ESP32S2
        default 1 if IDF_TARGET_ESP32S2
        help
            UART communication port number for Modbus example.

    config MB_UART_BAUD_RATE
        int "UART communication speed"
        range 1200 115200
        default 115200
        help
            UART communication speed for Modbus example.

    config MB_UART_RXD
        int "UART RXD pin number"
        range 0 34 if IDF_TARGET_ESP32
        default 22 if IDF_TARGET_ESP32
        range 0 46 if IDF_TARGET_ESP32S2
        default 19 if IDF_TARGET_ESP32S2
        help
            GPIO number for UART RX pin. See UART documentation for more information
            about available pin numbers for UART.

    config MB_UART_TXD
        int "UART TXD pin number"
        range 0 34 if IDF_TARGET_ESP32
        default 23 if IDF_TARGET_ESP32
        range 0 46 if IDF_TARGET_ESP32S2
        default 20 if IDF_TARGET_ESP32S2
        help
            GPIO number for UART TX pin. See UART documentation for more information
            about available pin numbers for UART.

    config MB_UART_RTS
        int "UART RTS pin number"
        range 0 34 if IDF_TARGET_ESP32
        range 0 46 if IDF_TARGET_ESP32S2
        default 18
        help
            GPIO number for UART RTS pin. This pin is connected to
            ~RE/DE pin of RS485 transceiver to switch direction.
            See UART documentation for more information about available pin
            numbers for UART.

    choice MB_COMM_MODE
        prompt "Modbus communication mode"
        default MB_COMM_MODE_RTU if CONFIG_FMB_COMM_MODE_RTU_EN
        help
            Selection of Modbus communication mode option for Modbus.

        config MB_COMM_MODE_RTU
            bool "RTU mode"
            depends on FMB_COMM_MODE_RTU_EN

        config MB_COMM_MODE_ASCII
            bool "ASCII mode"
            depends on FMB_COMM_MODE_ASCII_EN

    endchoice

endmenu
```

## examples/protocols/pppos_client/sdkconfig.defaults
```kconfig
CONFIG_EXAMPLE_MODEM_UART_TX_PIN=5
CONFIG_EXAMPLE_MODEM_UART_RX_PIN=13
# Override some defaults to enable PPP
CONFIG_LWIP_PPP_SUPPORT=y
CONFIG_LWIP_PPP_NOTIFY_PHASE_SUPPORT=y
CONFIG_LWIP_PPP_PAP_SUPPORT=y
CONFIG_LWIP_TCPIP_TASK_STACK_SIZE=4096
# Do not enable IPV6 in dte<->dce link local
CONFIG_LWIP_PPP_ENABLE_IPV6=n
CONFIG_EXAMPLE_MODEM_APN="CMNET"
CONFIG_EXAMPLE_MODEM_PPP_AUTH_USERNAME="www.coltsmart.com"
CONFIG_EXAMPLE_MODEM_PPP_AUTH_PASSWORD="coltsmart"
CONFIG_MQTT_TRANSPORT_SSL=n
CONFIG_ETH_ENABLED=n
CONFIG_UART_ISR_IN_IRAM=y
CONFIG_EXAMPLE_MODEM_UART_RX_BUFFER_SIZE=2048
CONFIG_EXAMPLE_MODEM_UART_TX_BUFFER_SIZE=2048
CONFIG_EXAMPLE_MODEM_UART_EVENT_QUEUE_SIZE=30
CONFIG_EXAMPLE_MODEM_UART_PATTERN_QUEUE_SIZE=20
CONFIG_EXAMPLE_MODEM_UART_EVENT_TASK_PRIORITY=22

#
# Modbus configuration
#
CONFIG_MB_UART_RXD=16
CONFIG_MB_UART_TXD=17
CONFIG_MB_UART_RTS=4
CONFIG_MB_UART_PORT_NUM=2
CONFIG_MB_COMM_MODE_RTU=y
CONFIG_MB_UART_BAUD_RATE=9600
CONFIG_FMB_TIMER_PORT_ENABLED=y
CONFIG_FMB_TIMER_GROUP=0
CONFIG_FMB_TIMER_INDEX=0
CONFIG_FMB_TIMER_ISR_IN_IRAM=y
CONFIG_FMB_MASTER_DELAY_MS_CONVERT=200
CONFIG_FMB_MASTER_TIMEOUT_MS_RESPOND=200

CONFIG_LOG_DEFAULT_LEVEL_INFO=y

#
# Partition Table
#
# CONFIG_PARTITION_TABLE_SINGLE_APP is not set
CONFIG_PARTITION_TABLE_TWO_OTA=y
# CONFIG_PARTITION_TABLE_CUSTOM is not set
CONFIG_PARTITION_TABLE_CUSTOM_FILENAME="partitions.csv"
CONFIG_PARTITION_TABLE_FILENAME="partitions_two_ota.csv"
CONFIG_PARTITION_TABLE_OFFSET=0x8000
CONFIG_PARTITION_TABLE_MD5=y
# end of Partition Table

# Default sdkconfig parameters to use the OTA
# partition table layout, with a 4MB flash size
CONFIG_ESPTOOLPY_FLASHSIZE_4MB=y
CONFIG_PARTITION_TABLE_TWO_OTA=y

#
# ESP HTTPS OTA
#
CONFIG_OTA_ALLOW_HTTP=y

# end of ESP HTTPS OTA
CONFIG_APP_PROJECT_VER_FROM_CONFIG=y
CONFIG_APP_PROJECT_VER="1.0"
CONFIG_ESP_TIMER_PROFILING=y
```
